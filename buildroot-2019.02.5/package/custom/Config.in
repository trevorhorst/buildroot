## buildroot-2019.02.5/package/custom/Config.in
```kconfig
menuconfig BR2_PACKAGE_CONTROLSOFTWARE
    bool "ControlSoftware"
    help
        This option enable support for the beaglebone black control software

if BR2_PACKAGE_CONTROLSOFTWARE
source "package/custom/ControlSoftware/Config.in"
endif	
```

## buildroot-2019.02.5/package/custom/ControlSoftware/Config.in
```kconfig
choice
    prompt "Control Software Version"

config BR2_PACKAGE_CONTROLSOFTWARE_GIT_LATEST_VERSION
    bool "Latest version (master)"
    help
        This option allows Buildroot to get the Control Software source

config BR2_PACKAGE_CONTROLSOFTWARE_GIT_CUSTOM_VERSION
    bool "Custom version"
    help
        This option allows Buildroot to get the Control Software source
        code from github using a specified custom version

config BR2_PACKAGE_CONTROLSOFTWARE_CUSTOM_LOCAL
    bool "Custom local version"
    help
        This option allows Buildroot to get the Control Software source
        code from a site local to the machine
endchoice

config BR2_PACKAGE_CONTROLSOFTWARE_GIT_CUSTOM_VERSION_VALUE
    string "RadioSoftware version"
    depends on BR2_PACKAGE_CONTROLSOFTWARE_GIT_CUSTOM_VERSION

config BR2_PACKAGE_CONTROLSOFTWARE_CUSTOM_LOCAL_LOCATION
    string "Path of custom site on machine"
    depends on BR2_PACKAGE_CONTROLSOFTWARE_CUSTOM_LOCAL

choice
    prompt "Control Software Project"

    config BR2_PACKAGE_CONTROLSOFTWARE_PROJECT_EXAMPLE
    bool "example"
    help
        This option builds the example control project

    config BR2_PACKAGE_CONTROLSOFTWARE_PROJECT_MLB
    bool "mlb"
    help
        This option builds the mlb project

    config BR2_PACKAGE_CONTROLSOFTWARE_PROJECT_BEAGLEBONEBLACK
    bool "beagleboneblack"
    help
        This option builds the beaglebone black project

endchoice

config BR2_PACKAGE_CONTROLSOFTWARE_PROJECT
    string
    default "example" if BR2_PACKAGE_CONTROLSOFTWARE_PROJECT_EXAMPLE
    default "mlb" if BR2_PACKAGE_CONTROLSOFTWARE_PROJECT_MLB
    default "beagleboneblack" if BR2_PACKAGE_CONTROLSOFTWARE_PROJECT_BEAGLEBONEBLACK

config BR2_PACKAGE_CONTROLSOFTWARE_VERSION
    string
    default "master" if BR2_PACKAGE_CONTROLSOFTWARE_GIT_LATEST_VERSION
    default BR2_PACKAGE_CONTROLSOFTWARE_GIT_CUSTOM_VERSION_VALUE \
        if BR2_PACKAGE_CONTROLSOFTWARE_GIT_CUSTOM_VERSION
    default "custom" if BR2_PACKAGE_CONTROLSOFTWARE_CUSTOM_LOCAL_LOCATION
```
